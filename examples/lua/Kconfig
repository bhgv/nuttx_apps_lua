## examples/lua/Kconfig
```kconfig
#
# For a description of the syntax of this configuration file,
# see the file kconfig-language.txt in the NuttX tools repository.
#

config EXAMPLES_LUA
	tristate "lua example"
	default n
	---help---
		Enable the lua example

if EXAMPLES_LUA
endif
```
